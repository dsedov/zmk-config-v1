## config/boards/shields/sedov_kb1/Kconfig.defconfig
```kconfig
# Copyright (c) 2020 The ZMK Contributors
# SPDX-License-Identifier: MIT

if SHIELD_SEDOV_KB1

config ZMK_KEYBOARD_NAME
    default "SEDOV1"

endif
```

## config/boards/shields/sedov_kb1/Kconfig.shield
```kconfig
 #
 # Copyright (c) 2020 The ZMK Contributors
 #
 # SPDX-License-Identifier: MIT
 #

config SHIELD_SEDOV_KB1
    def_bool $(shields_list_contains,sedov_kb1)
```
